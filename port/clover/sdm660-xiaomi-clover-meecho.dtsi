/*
 * What MEECHO says about the Mi Pad 4 that its mainline device tree
 * (sdm660-xiaomi-clover.dts, sdm660-mainline) does not: statements about
 * the board, not about a driver.  mkboot.sh compiles the mainline tree with
 * this file after it, and the image carries the result; the tree as
 * mainline has it stays next to it for the host stands.
 *
 * The USB-C port is dual-role.  Mainline says "peripheral" because it has
 * no driver for what makes it a host - the PM660 charger's Type-C block
 * and its VBUS boost - and the tablet's own Android tree says "otg" for
 * the same controller, with the role from the charger
 * (port/clover/hw-usbhost.md, section 3).  MEECHO's xhci takes a core only
 * when the tree lets it be a host; which role the port has at a given
 * moment is decided by Type-C (qcom_pmic, usbrole), not here.
 */

&usb3_dwc3 {
	dr_mode = "otg";
};

/*
 * The blocks that set the two CPU clusters' clock and voltage, which
 * mainline does not describe at all (port/clover/hw-cpu.md, section 1):
 * one node, meecho,sdm660-cpu-dvfs, for qcom_cpufreq (which writes only
 * the clusters' mux and PLL) and the read-only probe.  It lives in a file
 * of its own because the qcom_cpufreq host stand adds it to the compiled
 * tree by itself, without this file's other statements.
 */
#include "sdm660-xiaomi-clover-cpu.dtsi"

/*
 * The modem's metadata carveout (port/clover/hw-modem.md, section 4).
 * Mainline gives it only alloc-ranges and a size, and Linux picks the
 * place at boot; this kernel does not place dynamic regions, so it is
 * fixed here, at the start of the range Linux picks from.  The modem's
 * loader gives these pages to the modem's VM through TrustZone while the
 * MBA checks the image's hashes: in ordinary RAM the kernel's cacheable
 * linear map would still cover them, a speculative fetch from it would be
 * an access to memory the modem owns, and TrustZone answers that by
 * resetting the SoC - the likeliest reading of the reset the tablet went
 * through when the metadata lay in a buffer of the loader's own RAM.
 */
&mdata_mem {
	reg = <0x0 0xa0000000 0x0 0x4000>;
};

/*
 * The IPA v2.6L (port/clover/hw-modem.md, section 9): the modem's data
 * path to the AP.  Mainline has no node for it; this is the node of the
 * ipa2-lite tree (github.com/valam84/linux, nura/sdm660-ipa), which
 * postmarketOS runs on this tablet - one window over the BAM (+0x4000),
 * the IPA's registers (+0x40000) and its SRAM (+0x45000), the RPM's IPA
 * clock, the IPA's and the BAM's lines, and its two stream IDs on the
 * apps SMMU, the one the Wi-Fi's are on too.  Its interconnect paths are
 * left out: MEECHO has no interconnect driver, and nothing here reads
 * them.
 */
&soc {
	ipa: ipa@14780000 {
		compatible = "qcom,sdm660-ipa", "qcom,ipa-lite-v2.6";
		reg = <0x14780000 0x4f000>;
		clocks = <&rpmcc RPM_SMD_IPA_CLK>;
		interrupts = <GIC_SPI 333 IRQ_TYPE_LEVEL_HIGH>,
			     <GIC_SPI 432 IRQ_TYPE_LEVEL_HIGH>;
		interrupt-names = "ipa", "dma";
		iommus = <&anoc2_smmu 0x19c0>,
			 <&anoc2_smmu 0x19c2>;
		modem-remoteproc = <&remoteproc_mss>;
	};
};
